## CMakeLists.txt
```
# SPDX-License-Identifier: Apache-2.0

cmake_minimum_required(VERSION 3.20.0)

find_package(Zephyr REQUIRED HINTS $ENV{ZEPHYR_BASE})
project(simple_aws_asset_tracker)

target_sources(app PRIVATE src/main.c src/json_common.c src/location_module.c src/modem_module.c)
```

## prj.conf
```kconfig
# Stacks and heaps
CONFIG_HEAP_MEM_POOL_SIZE=40000
CONFIG_MAIN_STACK_SIZE=8192
CONFIG_SYSTEM_WORKQUEUE_STACK_SIZE=4096
CONFIG_LOG_BUFFER_SIZE=2048

# Enble GPIO for buttons/LEDs
CONFIG_GPIO=y

# Necessary to have printouts of floating point numbers
CONFIG_FPU=y
CONFIG_PICOLIBC=y

# Print a banner on the UART on startup.
CONFIG_BOOT_BANNER=y

# Enable console and printk()
CONFIG_PRINTK=y
CONFIG_STDOUT_CONSOLE=y

# Enable Zephyr application to be booted by MCUboot
CONFIG_BOOTLOADER_MCUBOOT=y

# Enable Zephyr console
CONFIG_CONSOLE=y

# Logging configuration
CONFIG_LOG=y
CONFIG_LOG_DEFAULT_LEVEL=4

# Modem configuration
CONFIG_MODEM_INFO=y
CONFIG_NRF_MODEM_LIB=y
CONFIG_MODEM_JWT=y
CONFIG_MODEM_JWT_MAX_LEN=4096
CONFIG_AT_HOST_LIBRARY=y
CONFIG_MODEM_KEY_MGMT=n

# LTE configuration
CONFIG_LTE_LINK_CONTROL=y
CONFIG_LTE_AUTO_INIT_AND_CONNECT=n
CONFIG_LTE_PSM_REQ=y


CONFIG_UART_INTERRUPT_DRIVEN=y

CONFIG_JSON_LIBRARY=y

# GNSS
CONFIG_LOCATION=y
CONFIG_LOCATION_METHOD_GNSS=y
CONFIG_LOCATION_METHOD_CELLULAR=y


CONFIG_DATE_TIME=y
CONFIG_NRF_CLOUD_REST=y
CONFIG_NRF_CLOUD_AGNSS=y

# Request PSM active time of 8 seconds.
CONFIG_LTE_PSM_REQ_RAT="00000100"
```

## overlay-aws.conf
```kconfig
#
# Copyright (c) 2021 Nordic Semiconductor ASA
#
# SPDX-License-Identifier: LicenseRef-Nordic-5-Clause
#
CONFIG_NETWORKING=y
CONFIG_NET_NATIVE=y
CONFIG_NET_SOCKETS=y
CONFIG_NET_IPV4=y
CONFIG_NET_CONNECTION_MANAGER=y

CONFIG_AWS_IOT=y
CONFIG_AWS_IOT_TOPIC_UPDATE_DELTA_SUBSCRIBE=n
CONFIG_AWS_IOT_TOPIC_GET_REJECTED_SUBSCRIBE=n
CONFIG_AWS_IOT_AUTO_DEVICE_SHADOW_REQUEST=n
CONFIG_AWS_IOT_MQTT_RX_TX_BUFFER_LEN=2048
CONFIG_AWS_IOT_APP_SUBSCRIPTION_LIST_COUNT=1
CONFIG_AWS_IOT_CLIENT_ID_APP=y
CONFIG_AWS_IOT_CONNECTION_POLL_THREAD=y

# Options that must be configured in order to establish a connection.
CONFIG_AWS_IOT_SEC_TAG=1337
CONFIG_AWS_IOT_BROKER_HOST_NAME="TODO.iot.us-east-1.amazonaws.com"
CONFIG_AWS_IOT_CLIENT_ID_STATIC="spectric-icarus"

# MQTT Transport library
# Maximum specified MQTT keepalive timeout for AWS IoT is 1200 seconds.
CONFIG_MQTT_KEEPALIVE=1200

CONFIG_AWS_IOT_MQTT_PAYLOAD_BUFFER_LEN=4200
#CONFIG_NRF_CLOUD_LOCATION=y
CONFIG_LOCATION_SERVICE_EXTERNAL=y
CONFIG_MQTT_CLEAN_SESSION=y
```

## src/main.c
```c
/*
 * SPDX-License-Identifier: Apache-2.0
 */

#include <net/aws_iot.h>
#include <stdio.h>
#include <zephyr/logging/log.h>
#include <zephyr/logging/log_ctrl.h>
#include <zephyr/sys/reboot.h>

#include <net/nrf_cloud_agnss.h>
#include <modem/modem_info.h>
#include <zephyr/drivers/gpio.h>

#include "json_common.h"
#include "location_module.h"
#include "modem_module.h"

LOG_MODULE_REGISTER(main);

/* Macro called upon a fatal error, reboots the device. */
#define FATAL_ERROR()					\
	LOG_ERR("Fatal error! Rebooting the device.");	\
	LOG_PANIC();					\
	IF_ENABLED(CONFIG_REBOOT, (sys_reboot(0)))

//////////////////////////////////////////////////////////////////////////////
// LEDs and Buttons
#define GPIO_NODE        DT_NODELABEL(gpio0)
#define RED_LED_NODE		DT_ALIAS(led0)
#define GREEN_LED_NODE		DT_ALIAS(led1)
#define BLUE_LED_NODE		DT_ALIAS(led2)

#define LED_OFF 0
#define LED_ON !LED_OFF

typedef enum {
	RED,
	GREEN,
	BLUE,
	MAGENTA,
	CYAN,
	YELLOW
} led_color_t;

static struct gpio_dt_spec red_led = GPIO_DT_SPEC_GET(RED_LED_NODE, gpios);
static struct gpio_dt_spec green_led = GPIO_DT_SPEC_GET(GREEN_LED_NODE, gpios);
static struct gpio_dt_spec blue_led = GPIO_DT_SPEC_GET(BLUE_LED_NODE, gpios);

static const struct device *gpio_dev;
//////////////////////////////////////////////////////////////////////////////

//////////////////////////////////////////////////////////////////////////////
// AWS
#define AWS_CLOUD_CLIENT_ID_LEN (sizeof(CONFIG_AWS_IOT_CLIENT_ID_STATIC) - 1)

#define AGNSS_REQUEST_TOPIC "nrfcloud/agps/get"
#define AGNSS_REQUEST_TOPIC_IDX 0

#define AGNSS_RESPONSE_TOPIC "nrfcloud/agps"
#define AGNSS_RESPONSE_TOPIC_LEN 1

static struct aws_iot_config config;
static char client_id_buf[AWS_CLOUD_CLIENT_ID_LEN + 1];

static struct aws_iot_topic_data pub_topics[1] = {
        [AGNSS_REQUEST_TOPIC_IDX].str = AGNSS_REQUEST_TOPIC,
        [AGNSS_REQUEST_TOPIC_IDX].len = strlen(AGNSS_REQUEST_TOPIC),
};

const struct aws_iot_topic_data sub_topics[CONFIG_AWS_IOT_APP_SUBSCRIPTION_LIST_COUNT] = {
        [0].str = AGNSS_RESPONSE_TOPIC,
        [0].len = strlen(AGNSS_RESPONSE_TOPIC),
};

K_SEM_DEFINE(aws_connected, 0, 1);
//////////////////////////////////////////////////////////////////////////////

static void print_hex(const char* buf, const size_t len) {
	for(size_t i=0; i<len; ++i) {
    	printf("%02X", (unsigned char)buf[i]);
	}
	printf("\n");
}

static void aws_iot_event_handler(const struct aws_iot_evt *const evt)
{
    int err;

	switch (evt->type) {
		case AWS_IOT_EVT_CONNECTING:
			LOG_INF("Connecting to AWS");
			break;
		case AWS_IOT_EVT_CONNECTED:
			LOG_INF("Connecting to AWS");
			if (evt->data.persistent_session) {
				LOG_WRN("Persistent session is enabled, using subscriptions "
						"from the previous session");
			}
			break;
		case AWS_IOT_EVT_READY:
			LOG_INF("AWS Ready");
			k_sem_give(&aws_connected);
			break;
		case AWS_IOT_EVT_DATA_RECEIVED:
			LOG_INF("AWS_IOT_EVT_DATA_RECEIVED");

			LOG_INF("Received message %d bytes on topic: \"%.*s\"",
									evt->data.msg.len,
									evt->data.msg.topic.len,
									evt->data.msg.topic.str);
			//print_hex(evt->data.msg.ptr, evt->data.msg.len);
			if (strncmp(evt->data.msg.topic.str, AGNSS_RESPONSE_TOPIC, evt->data.msg.topic.len) == 0) {
				err = nrf_cloud_agnss_process(evt->data.msg.ptr, evt->data.msg.len);
				if (err) {
					LOG_ERR("Unable to process A-GNSS data, error: %d", err);
				}
			}
			break;
		case AWS_IOT_EVT_DISCONNECTED:
			LOG_INF("AWS Disconnected");
			break;
		case AWS_IOT_EVT_ERROR:
			LOG_ERR("AWS Err");
			break;
		default:
            LOG_DBG("AWS event %d", evt->type);
	}
}

static int update_aws_shadow() {
	// Get modem info
	int err;
	static struct modem_param_info modem_info = {0};

	err = modem_info_params_init(&modem_info);
	if (err) {
		return err;
	}
	
	err = modem_info_params_get(&modem_info);
	if (err) {
		return err;
	}

	char buf[4096];
	bool ack = false;

	struct shadow payload = {
		.state.reported.uptime = k_uptime_get(),
		.state.reported.mcc = modem_info.network.mcc.value,
		.state.reported.mnc = modem_info.network.mnc.value,
		.state.reported.tac = modem_info.network.area_code.value,
		.state.reported.eci = modem_info.network.cellid_dec,
	};

	err = json_shadow_construct(buf, sizeof(buf), &payload);
	if (err) {
		LOG_ERR("json_shadow_construct, error: %d", err);
		FATAL_ERROR();
		return err;
	}

	struct aws_iot_data msg = {
		.ptr = buf,
		.len = strlen(buf),
		.message_id = 1,
		.qos = ack ? MQTT_QOS_1_AT_LEAST_ONCE : MQTT_QOS_0_AT_MOST_ONCE,
		.topic.type = AWS_IOT_SHADOW_TOPIC_UPDATE,
	};

	LOG_INF("Publishing message: %s to AWS IoT shadow", buf);

	err = aws_iot_send(&msg);
	if (err) {
		printf("aws_iot_send, error: %d\n", err);
		return err;
	}

	return 0;
}

static int aws_agnss_req() {
	// Get modem info
	int err;
	static struct modem_param_info modem_info = {0};

	err = modem_info_params_init(&modem_info);
	if (err) {
		return err;
	}
	
	err = modem_info_params_get(&modem_info);
	if (err) {
		return err;
	}

	char buf[4096];
	bool ack = false;

	struct agnss_request payload = {
		.mcc = modem_info.network.mcc.value,
		.mnc = modem_info.network.mnc.value,
		.tac = modem_info.network.area_code.value,
		.eci = modem_info.network.cellid_dec,
		.rsrp = modem_info.network.rsrp.value,
		.filtered = true,
		.mask = 5,
	};

	err = json_agnss_req_construct(buf, sizeof(buf), &payload);
	if (err) {
		LOG_ERR("json_payload_construct, error: %d", err);
		FATAL_ERROR();
		return err;
	}

	struct aws_iot_data msg = {
		.ptr = buf,
		.len = strlen(buf),
		.message_id = 1,
		.qos = ack ? MQTT_QOS_1_AT_LEAST_ONCE : MQTT_QOS_0_AT_MOST_ONCE,
		.topic = pub_topics[AGNSS_REQUEST_TOPIC_IDX],
	};

	LOG_INF("Publishing message: %s to AWS IoT shadow", buf);

	err = aws_iot_send(&msg);
	if (err) {
		printf("aws_iot_send, error: %d\n", err);
		return err;
	}

	return 0;
}

int gpio_init(void)
{
	int err;

	gpio_dev = DEVICE_DT_GET(GPIO_NODE);
	if (!gpio_dev) {
		LOG_ERR("LED initialization failed, err %d", err);
		return err;
	}

	gpio_pin_configure_dt(&red_led, GPIO_OUTPUT_INACTIVE);
	gpio_pin_configure_dt(&green_led, GPIO_OUTPUT_INACTIVE);
	gpio_pin_configure_dt(&blue_led, GPIO_OUTPUT_INACTIVE);

	return 0;
}

void set_led(int red, int green, int blue)
{
	gpio_pin_set_dt(&red_led, red);
	gpio_pin_set_dt(&green_led, green);
	gpio_pin_set_dt(&blue_led, blue);
}

int main(void)
{
	int err;

	printf("Simple AWS Asset Tracker %s\n", CONFIG_AWS_IOT_CLIENT_ID_STATIC);
	err = gpio_init();
	if (err) {
		LOG_ERR("GPIO initialization failed, err %d", err);
		FATAL_ERROR();
		return err;
	}
	
	//////////////////////////////////////////////////////////////////////////
	// Setup Modem and connect to LTE network

	set_led(LED_ON /* red */, LED_OFF /* green */, LED_OFF /* blue */);
	
	err = modem_mod_init();
	if (err) {
		LOG_ERR("Modem initialization failed, err %d", err);
		FATAL_ERROR();
		return err;
	}

	err = modem_mod_connect();
	if (err) {
		LOG_ERR("Modem connection failed, err %d", err);
		FATAL_ERROR();
		return err;
	}

	set_led(LED_ON /* red */, LED_OFF /* green */, LED_ON /* blue */);

	//////////////////////////////////////////////////////////////////////////
	// Try to get initial location and then setup periodic location

	err = location_mod_init();
	if (err) {
		LOG_ERR("location module init error: %d", err);
		FATAL_ERROR();
		return err;
	}
	
	LOG_INF("Requesting location...");
	err = location_with_fallback_get();
	if (err) {
		LOG_ERR("Requesting location failed, error: %d", err);
	}

	LOG_INF("Periodic location...");
	location_gnss_periodic_get();

	set_led(LED_OFF /* red */, LED_ON /* green */, LED_OFF /* blue */);

	//////////////////////////////////////////////////////////////////////////
	// Connect to AWS IoT
	
	// AWS
	LOG_INF("Connecting to AWS...");
	// AWS Hello World
	snprintf(client_id_buf, sizeof(client_id_buf), "%s", CONFIG_AWS_IOT_CLIENT_ID_STATIC);

	config.client_id = client_id_buf;
	config.client_id_len = strlen(client_id_buf);

	err = aws_iot_init(&config, aws_iot_event_handler);
	if (err) {
		LOG_ERR("aws_iot_init, error: %d", err);
		FATAL_ERROR();
		return err;
	}

	LOG_INF("Subscribing to topics...");
	err = aws_iot_subscription_topics_add(sub_topics, ARRAY_SIZE(sub_topics));
	if (err) {
        LOG_ERR("aws_iot_subscription_topics_add, error: %d", err);
		FATAL_ERROR();
        return err;
	}

	err = aws_iot_connect(&config);
	if (err) {
		LOG_ERR("aws_iot_init, error: %d", err);
		FATAL_ERROR();
		return err;
	}

	LOG_INF("Waiting for AWS...");
	k_sem_take(&aws_connected, K_FOREVER);
	LOG_INF("Connected to AWS network!");

	set_led(LED_OFF /* red */, LED_OFF /* green */, LED_ON /* blue */);

	update_aws_shadow();

	aws_agnss_req();

	while (1 == 1) {
		err = aws_iot_ping();
		if (err) {
			printf("aws_iot_ping, error: %d\n", err);
		}
		printf("waiting...\n");
		
		k_sleep(K_MSEC(10000));
	}
	
	return 0;
}
```

## src/certificates.h
```c
static char AWS_IOT_CA_CERT[] = "FILL-IN";
static char AWS_IOT_CL_CERT[] = "FILL-IN";
static char AWS_IOT_CL_PRIV[] = "FILL-IN";
```

## src/json_common.c
```c
#include <zephyr/logging/log.h>

#include "json_common.h"

LOG_MODULE_REGISTER(json_common);

int json_shadow_construct(char *message, size_t size, struct shadow *payload)
{
	int err;
	const struct json_obj_descr parameters[] = {
		JSON_OBJ_DESCR_PRIM_NAMED(struct shadow, "uptime",
					  state.reported.uptime, JSON_TOK_NUMBER),
		JSON_OBJ_DESCR_PRIM_NAMED(struct shadow, "mcc",
					  state.reported.mcc, JSON_TOK_NUMBER),
		JSON_OBJ_DESCR_PRIM_NAMED(struct shadow, "mnc",
					  state.reported.mnc, JSON_TOK_NUMBER),
		JSON_OBJ_DESCR_PRIM_NAMED(struct shadow, "tac",
					  state.reported.tac, JSON_TOK_NUMBER),					  
		JSON_OBJ_DESCR_PRIM_NAMED(struct shadow, "eci",
					  state.reported.eci, JSON_TOK_NUMBER),	
	};
	const struct json_obj_descr reported[] = {
		JSON_OBJ_DESCR_OBJECT_NAMED(struct shadow, "reported", state.reported,
					    parameters),
	};
	const struct json_obj_descr root[] = {
		JSON_OBJ_DESCR_OBJECT(struct shadow, state, reported),
	};

	err = json_obj_encode_buf(root, ARRAY_SIZE(root), payload, message, size);
	if (err) {
		LOG_ERR("json_obj_encode_buf, error: %d", err);
		return err;
	}

	return 0;
}

int json_agnss_req_construct(char *message, size_t size, struct agnss_request *payload)
{
	int err;
	const struct json_obj_descr root[] = {
		JSON_OBJ_DESCR_PRIM_NAMED(struct agnss_request, "mcc",
					  mcc, JSON_TOK_NUMBER),
		JSON_OBJ_DESCR_PRIM_NAMED(struct agnss_request, "mnc",
					  mnc, JSON_TOK_NUMBER),
		JSON_OBJ_DESCR_PRIM_NAMED(struct agnss_request, "tac",
					  tac, JSON_TOK_NUMBER),					  
		JSON_OBJ_DESCR_PRIM_NAMED(struct agnss_request, "eci",
					  eci, JSON_TOK_NUMBER),
		JSON_OBJ_DESCR_PRIM_NAMED(struct agnss_request, "rsrp",
					  rsrp, JSON_TOK_NUMBER),
		JSON_OBJ_DESCR_PRIM_NAMED(struct agnss_request, "filtered",
					  rsrp, JSON_TOK_TRUE),
	};

	err = json_obj_encode_buf(root, ARRAY_SIZE(root), payload, message, size);
	if (err) {
		LOG_ERR("json_obj_encode_buf, error: %d", err);
		return err;
	}

	return 0;
}
```

## src/json_common.h
```c
#ifndef JSON_COMMON_H__
#define JSON_COMMON_H__

#include <zephyr/data/json.h>

struct shadow {
	struct {
		struct {
			uint32_t uptime;
			uint16_t mcc;
			uint16_t mnc;
			uint16_t tac;
			double eci;
		} reported;
	} state;
};

struct agnss_request {
	int mcc;
	int mnc;
	int tac;
	double eci;
	int rsrp;
	bool filtered;
	int mask;
};

int json_shadow_construct(char *message, size_t size, struct shadow *payload);

int json_agnss_req_construct(char *message, size_t size, struct agnss_request *payload);

#endif
```

## src/location_module.c
```c
#include <modem/location.h>
#include <zephyr/logging/log.h>

#include "location_module.h"

LOG_MODULE_REGISTER(location_module);

static K_SEM_DEFINE(location_event, 0, 1);

int location_mod_init(void)
{
    int err;
    
    LOG_INF("Setting up location...");
	err = location_init(location_event_handler);
	if (err) {
		LOG_ERR("Initializing the Location library failed, error: %d", err);
		return err;
	}

    return 0;
}

void location_event_handler(const struct location_event_data *event_data)
{
	switch (event_data->id) {
	case LOCATION_EVT_LOCATION:
		printk("Got location:\n");
		printk("  method: %s\n", location_method_str(event_data->method));
		printk("  latitude: %.06f\n", event_data->location.latitude);
		printk("  longitude: %.06f\n", event_data->location.longitude);
		printk("  accuracy: %.01f m\n", event_data->location.accuracy);
		if (event_data->location.datetime.valid) {
			printk("  date: %04d-%02d-%02d\n",
				event_data->location.datetime.year,
				event_data->location.datetime.month,
				event_data->location.datetime.day);
			printk("  time: %02d:%02d:%02d.%03d UTC\n",
				event_data->location.datetime.hour,
				event_data->location.datetime.minute,
				event_data->location.datetime.second,
				event_data->location.datetime.ms);
		}
		printk("  Google maps URL: https://maps.google.com/?q=%.06f,%.06f\n\n",
			event_data->location.latitude, event_data->location.longitude);
		break;

	case LOCATION_EVT_TIMEOUT:
		printk("Getting location timed out\n\n");
		break;

	case LOCATION_EVT_ERROR:
		printk("Getting location failed\n\n");
		break;

	case LOCATION_EVT_GNSS_ASSISTANCE_REQUEST:
		printk("Getting location assistance requested (A-GNSS). Not doing anything.\n\n");
		break;

	case LOCATION_EVT_GNSS_PREDICTION_REQUEST:
		printk("Getting location assistance requested (P-GPS). Not doing anything.\n\n");
		break;

	default:
		printk("Getting location: Unknown event\n\n");
		break;
	}

	k_sem_give(&location_event);
}

int location_with_fallback_get(void)
{
	int err;
	struct location_config config;
	enum location_method methods[] = {LOCATION_METHOD_GNSS, LOCATION_METHOD_CELLULAR};

	location_config_defaults_set(&config, ARRAY_SIZE(methods), methods);
	/* GNSS timeout is set to 1 second to force a failure. */
	config.methods[0].gnss.timeout = 100 * MSEC_PER_SEC;
	/* Default cellular configuration may be overridden here. */
	config.methods[1].cellular.timeout = 40 * MSEC_PER_SEC;

	LOG_INF("Requesting location with long GNSS timeout with fallback to cellular...\n");

	err = location_request(&config);
	if (err) {
		return err;
	}

	k_sem_take(&location_event, K_FOREVER);

	return 0;
}

void location_gnss_periodic_get(void)
{
	int err;
	struct location_config config;
	enum location_method methods[] = {LOCATION_METHOD_GNSS, LOCATION_METHOD_CELLULAR};

	location_config_defaults_set(&config, ARRAY_SIZE(methods), methods);
	config.interval = 30;

	printk("Requesting 30s periodic GNSS location with cellular fallback...\n");

	err = location_request(&config);
	if (err) {
		printk("Requesting location failed, error: %d\n", err);
		return;
	}
}
```

## src/location_module.h
```c
#ifndef LOCATION_MODULE_H__
#define LOCATION_MODULE_H__

#include <modem/location.h>


int location_mod_init(void);

void location_event_handler(const struct location_event_data *event_data);

int location_with_fallback_get(void);

void location_gnss_periodic_get(void);

#endif
```

## src/modem_module.c
```c
#include <zephyr/logging/log.h>
#include <modem/modem_jwt.h>
#include <modem/modem_key_mgmt.h>
#include <modem/modem_info.h>
#include <zephyr/net/conn_mgr_connectivity.h>
#include <modem/lte_lc.h>
#include <modem/nrf_modem_lib.h>
#include <zephyr/drivers/uart.h>
#include <zephyr/drivers/clock_control.h>
#include <zephyr/drivers/clock_control/nrf_clock_control.h>

#include "modem_module.h"
#include "certificates.h"

LOG_MODULE_REGISTER(modem_module);

static K_SEM_DEFINE(lte_connected, 0, 1);
static K_SEM_DEFINE(time_update_finished, 0, 1);


void lte_handler(const struct lte_lc_evt *const evt)
{
	switch (evt->type) {
        case LTE_LC_EVT_NW_REG_STATUS:
                if (evt->nw_reg_status != LTE_LC_NW_REG_REGISTERED_HOME &&
                    evt->nw_reg_status != LTE_LC_NW_REG_REGISTERED_ROAMING) {
                        break;
                }

                LOG_INF("Connected to: %s network\n",
                       evt->nw_reg_status == LTE_LC_NW_REG_REGISTERED_HOME ? "home" : "roaming");

                k_sem_give(&lte_connected);
                break;

        case LTE_LC_EVT_PSM_UPDATE:
			LOG_INF("PSM mode: %s", evt->rrc_mode == LTE_LC_RRC_MODE_CONNECTED ? "Connected" : "Idle");
			break;
        case LTE_LC_EVT_EDRX_UPDATE:
		case LTE_LC_EVT_RRC_UPDATE:
			LOG_INF("RRC mode: %s", evt->rrc_mode == LTE_LC_RRC_MODE_CONNECTED ? "Connected" : "Idle");
			break;
        case LTE_LC_EVT_CELL_UPDATE:
        case LTE_LC_EVT_LTE_MODE_UPDATE:
        case LTE_LC_EVT_TAU_PRE_WARNING:
        case LTE_LC_EVT_NEIGHBOR_CELL_MEAS:
        case LTE_LC_EVT_MODEM_SLEEP_EXIT_PRE_WARNING:
        case LTE_LC_EVT_MODEM_SLEEP_EXIT:
        case LTE_LC_EVT_MODEM_SLEEP_ENTER:
        case LTE_LC_EVT_MODEM_EVENT:
                /* Handle LTE events */
                break;

        default:
                break;
	}
}

void enable_xtal(void)
{
	struct onoff_manager *clk_mgr;
	static struct onoff_client cli = {};

	clk_mgr = z_nrf_clock_control_get_onoff(CLOCK_CONTROL_NRF_SUBSYS_HF);
	sys_notify_init_spinwait(&cli.notify);
	(void)onoff_request(clk_mgr, &cli);
}

void date_time_evt_handler(const struct date_time_evt *evt)
{
	k_sem_give(&time_update_finished);
}

int modem_mod_init(void) {
    int err;

    LOG_INF("Initializing modem library...");
	err = nrf_modem_lib_init();
	if (err) {
		LOG_ERR("Modem initialization failed, err %d", err);
		return err;
	}

    // in some examples, it was considered necessary to 
    // adjust the clock control to get the modem AT commands
    // to work
    enable_xtal(); 

	modem_info_init();

    // Get the modem UUID
    // TODO consider replacing with CONFIG_HW_ID_LIBRARY
    struct nrf_device_uuid dev = {0};
	err = modem_jwt_get_uuids(&dev, NULL);
	if (err) {
		LOG_ERR("Get device UUID error: %d", err);
	} else {
		printk("Modem attestation %s\n", dev.str);
	}

	// Get Modem IEMI/CCID
	LOG_INF("Getting modem info...");
	char imei[32] = {'\0',};
	char ccid[32] = {'\0',};

	//modem_info_params_get(&modem_param);
	modem_info_string_get(MODEM_INFO_IMEI, imei, sizeof(imei));
	modem_info_string_get(MODEM_INFO_ICCID, ccid, sizeof(ccid));

	LOG_INF("Modem IMEI: %s", imei);
	LOG_INF("Modem CCID: %s", ccid);

    return 0;
}

int modem_mod_connect(void) {
    int err;

    if (IS_ENABLED(CONFIG_DATE_TIME)) {
		/* Registering early for date_time event handler to avoid missing
		 * the first event after LTE is connected.
		 */
		date_time_register_handler(date_time_evt_handler);
	}

	// Connect to LTE
	LOG_INF("Connecting to LTE network. This may take a few minutes...");
	lte_lc_psm_req(true);
	lte_lc_func_mode_set(LTE_LC_FUNC_MODE_NORMAL);
	err = lte_lc_init_and_connect_async(lte_handler);
	if (err) {
		LOG_ERR("Connecting to network failed, err %d", err);
		return err;
	}

	// Wait for connection
	k_sem_take(&lte_connected, K_FOREVER);
	LOG_INF("Connected to LTE network!");

    /* A-GNSS/P-GPS needs to know the current time. */
	if (IS_ENABLED(CONFIG_DATE_TIME)) {
		printk("Waiting for current time\n");

		/* Wait for an event from the Date Time library. */
		k_sem_take(&time_update_finished, K_MINUTES(10));

		if (!date_time_is_valid()) {
			printk("Failed to get current time. Continuing anyway.\n");
		}
	}

    return 0;
}

int network_info_log(void)
{
    LOG_DBG("====== Cell Network Info ======");
    char sbuf[1024];
    modem_info_string_get(MODEM_INFO_RSRP, sbuf, sizeof(sbuf));
    LOG_DBG("Signal strength: %s", sbuf);
    modem_info_string_get(MODEM_INFO_CUR_BAND, sbuf, sizeof(sbuf));
    LOG_DBG("Current LTE band: %s", sbuf);
    modem_info_string_get(MODEM_INFO_SUP_BAND, sbuf, sizeof(sbuf));
    LOG_DBG("Supported LTE bands: %s", sbuf);
    modem_info_string_get(MODEM_INFO_AREA_CODE, sbuf, sizeof(sbuf));
    LOG_DBG("Tracking area code: %s", sbuf);
    modem_info_string_get(MODEM_INFO_UE_MODE, sbuf, sizeof(sbuf));
    LOG_DBG("Current mode: %s", sbuf);
    modem_info_string_get(MODEM_INFO_OPERATOR, sbuf, sizeof(sbuf));
    LOG_DBG("Current operator name: %s", sbuf);
    modem_info_string_get(MODEM_INFO_CELLID, sbuf, sizeof(sbuf));
    LOG_DBG("Cell ID of the device: %s", sbuf);
    modem_info_string_get(MODEM_INFO_IP_ADDRESS, sbuf, sizeof(sbuf));
    LOG_DBG("IP address of the device: %s", sbuf);
    modem_info_string_get(MODEM_INFO_FW_VERSION, sbuf, sizeof(sbuf));
    LOG_DBG("Modem firmware version: %s", sbuf);
    modem_info_string_get(MODEM_INFO_LTE_MODE, sbuf, sizeof(sbuf));
    LOG_DBG("LTE-M support mode: %s", sbuf);
    modem_info_string_get(MODEM_INFO_NBIOT_MODE, sbuf, sizeof(sbuf));
    LOG_DBG("NB-IoT support mode: %s", sbuf);
    modem_info_string_get(MODEM_INFO_GPS_MODE, sbuf, sizeof(sbuf));
    LOG_DBG("GPS support mode: %s", sbuf);
    modem_info_string_get(MODEM_INFO_DATE_TIME, sbuf, sizeof(sbuf));
    LOG_DBG("Mobile network time and date: %s", sbuf);
    LOG_DBG("===============================");
    return 0;
}

void init_certificates(void)
{
/////////////////
	// Check AWS credentials
	LOG_ERR("Getting certificate for SEC TAG %d", CONFIG_AWS_IOT_SEC_TAG);

	static char cred[4096];
	size_t cred_sz;
	bool cred_exists;
	int err;

	// Check for existance
	err =  modem_key_mgmt_exists(
		CONFIG_AWS_IOT_SEC_TAG,
		MODEM_KEY_MGMT_CRED_TYPE_CA_CHAIN,
		&cred_exists
	);
	if (err || cred_exists == false) {
		LOG_ERR("Failed to check CA certificate for SEC TAG %d with err %d", CONFIG_AWS_IOT_SEC_TAG, err);
	} else {
		LOG_INF("CA certificate exists");
	}

	err =  modem_key_mgmt_exists(
		CONFIG_AWS_IOT_SEC_TAG,
		MODEM_KEY_MGMT_CRED_TYPE_PRIVATE_CERT,
		&cred_exists
	);
	if (err || cred_exists == false) {
		LOG_ERR("Failed to check CA certificate for SEC TAG %d with err %d", CONFIG_AWS_IOT_SEC_TAG, err);
	} else {
		LOG_INF("private key exists");
	}

	err =  modem_key_mgmt_exists(
		CONFIG_AWS_IOT_SEC_TAG,
		MODEM_KEY_MGMT_CRED_TYPE_PUBLIC_CERT,
		&cred_exists
	);
	if (err || cred_exists == false) {
		LOG_ERR("Failed to check CA certificate for SEC TAG %d with err %d", CONFIG_AWS_IOT_SEC_TAG, err);
	} else {
		LOG_INF("public cert exists");
	}

	// Read certificates
	cred_sz = sizeof(cred);
	err = modem_key_mgmt_read(
		CONFIG_AWS_IOT_SEC_TAG,
		MODEM_KEY_MGMT_CRED_TYPE_CA_CHAIN,
		cred,
		&cred_sz
	);
	if (err) {
		LOG_ERR("Failed to get CA certificate for SEC TAG %d with err %d", CONFIG_AWS_IOT_SEC_TAG, err);
	} else {
		cred[cred_sz+1] = 0;
		LOG_INF("CA certificate %s", cred);
	}
	

	cred_sz = sizeof(cred);
	err = modem_key_mgmt_read(
		CONFIG_AWS_IOT_SEC_TAG,
		MODEM_KEY_MGMT_CRED_TYPE_PRIVATE_CERT,
		cred,
		&cred_sz
	);
	if (err) {
		LOG_ERR("Failed to get private key for SEC TAG %d with err %d", CONFIG_AWS_IOT_SEC_TAG, err);
	} else {
		cred[cred_sz+1] = 0;
		LOG_INF("private key %s", cred);
	}

	cred_sz = sizeof(cred);
	err = modem_key_mgmt_read(
		CONFIG_AWS_IOT_SEC_TAG,
		MODEM_KEY_MGMT_CRED_TYPE_PUBLIC_CERT,
		cred,
		&cred_sz
	);
	if (err) {
		LOG_ERR("Failed to get certificate for SEC TAG %d with err %d", CONFIG_AWS_IOT_SEC_TAG, err);
	} else {
		cred[cred_sz+1] = 0;
		LOG_INF("certificate %s", cred);
	}
}
```

## src/modem_module.h
```c
#ifndef MODEM_MODULE_H__
#define MODEM_MODULE_H__

void lte_handler(const struct lte_lc_evt *const evt);

int modem_mod_init(void);

int modem_mod_connect(void);

#endif
```
